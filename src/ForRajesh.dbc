VERSION ""

NS_ :

BS_:

BU_: Vector__XXX

BO_ 2566869221 SAMPLE_MSG: 8 Vector__XXX
 SG_ SPEED : 0|8@1+ (1,0) [0|255] "" Vector__XXX
 SG_ TEMP : 8|8@1+ (1,0) [0|255] "" Vector__XXX

CM_ BO_ 2566869221 "Sample message for tests";
